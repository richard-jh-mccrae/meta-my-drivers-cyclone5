## conf/layer.conf
```bitbake
# We have a conf and classes directory, add to BBPATH
BBPATH .= ":${LAYERDIR}"

# Driver files
BBFILES += "${LAYERDIR}/recipes-*/*/*.bb \
            ${LAYERDIR}/recipes-*/*/*.bbappend"

BBFILE_COLLECTIONS += "meta-my-drivers-cyclone5"
BBFILE_PATTERN_meta-my-drivers-cyclone5 = "^${LAYERDIR}/"
BBFILE_PRIORITY_meta-my-drivers-cyclone5 = "6"

LAYERDEPENDS_meta-my-drivers-cyclone5 = "core"
LAYERSERIES_COMPAT_meta-my-drivers-cyclone5 = "kirkstone"

# COMPATIBLE_MACHINE = '(cyclone5)'
```
